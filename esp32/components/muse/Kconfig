## esp32/components/muse/Kconfig
```kconfig
# Copyright (c) Meta Platforms, Inc. and affiliates.
#
# Licensed under the Apache License, Version 2.0 (the "License");
# you may not use this file except in compliance with the License.
# You may obtain a copy of the License at
#
#     http://www.apache.org/licenses/LICENSE-2.0
#
# Unless required by applicable law or agreed to in writing, software
# distributed under the License is distributed on an "AS IS" BASIS,
# WITHOUT WARRANTIES OR CONDITIONS OF ANY KIND, either express or implied.
# See the License for the specific language governing permissions and
# limitations under the License.

menu "Muse"

    choice MUSE_BOARD
        prompt "Board with the full UI"
        default MUSE_BOARD_NONE
        help
            The UI is the voice companion on boards with a screen: an
            animated avatar, push-to-talk chat, settings, and battery
            handling. It runs beside Home Link, which owns Wi-Fi, BLE
            pairing, credentials and OTA. Pick the board it runs on, or none
            for a Link without a display.

        config MUSE_BOARD_NONE
            bool "None (Home Link without a display)"

        config MUSE_BOARD_WAVESHARE_S3_175C
            bool "Waveshare ESP32-S3-Touch-AMOLED-1.75C"
            depends on IDF_TARGET_ESP32S3

        config MUSE_BOARD_WAVESHARE_S3_175
            bool "Waveshare ESP32-S3-Touch-AMOLED-1.75 (not the 1.75C)"
            depends on IDF_TARGET_ESP32S3

        config MUSE_BOARD_WAVESHARE_S3_216
            bool "Waveshare ESP32-S3-Touch-AMOLED-2.16"
            depends on IDF_TARGET_ESP32S3

        config MUSE_BOARD_AIPI
            bool "AIPI Lite (ESP32-S3, two buttons, no touch)"
            depends on IDF_TARGET_ESP32S3

        config MUSE_BOARD_ESPRESSIF_BOX_3
            bool "Espressif ESP32-S3-BOX-3 (320x240 touch LCD, speaker and microphones)"
            depends on IDF_TARGET_ESP32S3

        config MUSE_BOARD_WAVESHARE_C6_18
            bool "Waveshare ESP32-C6-Touch-AMOLED-1.8"
            depends on IDF_TARGET_ESP32C6

        config MUSE_BOARD_WAVESHARE_C6_206
            bool "Waveshare ESP32-C6-Touch-AMOLED-2.06"
            depends on IDF_TARGET_ESP32C6

        config MUSE_BOARD_SENSECAP_WATCHER
            bool "Seeed SenseCAP Watcher (ESP32-S3, round touch LCD, wheel)"
            depends on IDF_TARGET_ESP32S3

        config MUSE_BOARD_M5STACK_CARDPUTER_ADV
            bool "M5Stack Cardputer ADV (ESP32-S3, keyboard, no PSRAM)"
            depends on IDF_TARGET_ESP32S3

        config MUSE_BOARD_M5STACK_STICKS3
            bool "M5Stack StickS3 (ESP32-S3, two buttons, no touch)"
            depends on IDF_TARGET_ESP32S3

        config MUSE_BOARD_M5STACK_STICKC_PLUS2
            bool "M5Stack StickC Plus2 (ESP32, two buttons, no touch)"
            depends on IDF_TARGET_ESP32

        config MUSE_BOARD_M5STACK_STOPWATCH
            bool "M5Stack StopWatch (ESP32-S3, round touch AMOLED)"
            depends on IDF_TARGET_ESP32S3

        config MUSE_BOARD_M5STACK_CORES3
            bool "M5Stack CoreS3 (ESP32-S3, 320x240 touch LCD, speaker and microphones)"
            depends on IDF_TARGET_ESP32S3

        config MUSE_BOARD_M5STACK_CORE2
            bool "M5Stack Core2 v1.0 (ESP32, touch LCD, touch-strip talk)"
            depends on IDF_TARGET_ESP32
        config MUSE_BOARD_FNK0104B
            bool "Freenove FNK0104B (ESP32-S3, 240x320 touch LCD, ES8311 speaker and mic)"
            depends on IDF_TARGET_ESP32S3
        config MUSE_BOARD_GUITION_JC3248W535
            bool "Guition JC3248W535 (ESP32-S3, 3.5\" 320x480 touch LCD, speaker)"
            depends on IDF_TARGET_ESP32S3

        config MUSE_BOARD_WAVESHARE_S3_LCD7
            bool "Waveshare ESP32-S3-Touch-LCD-7 (800x480 touch LCD, no audio)"
            depends on IDF_TARGET_ESP32S3
        config MUSE_BOARD_VN_S3_183
            bool "VN ESP32-S3 board (1.83\" 284x240 NV3023 LCD, ES8311 and ES7210)"
            depends on IDF_TARGET_ESP32S3
        config MUSE_BOARD_AI_PASSPORT
            bool "FoloToy AI Passport (ESP32-C3, three buttons, no touch)"
            depends on IDF_TARGET_ESP32C3
        config MUSE_BOARD_ES3C28P
            bool "ES3C28P / ES3N28P (ESP32-S3, 2.8\" 240x320 ILI9341 touch LCD, ES8311)"
            depends on IDF_TARGET_ESP32S3
    endchoice

    config MUSE_ENABLED
        bool
        default y if !MUSE_BOARD_NONE

    # Always defined, unlike the target-dependent board options, so
    # idf_component.yml rules can select each board's managed components.
    config MUSE_BOARD_ID
        string
        default "waveshare_s3_175c" if MUSE_BOARD_WAVESHARE_S3_175C
        default "waveshare_s3_175" if MUSE_BOARD_WAVESHARE_S3_175
        default "waveshare_s3_216" if MUSE_BOARD_WAVESHARE_S3_216
        default "aipi" if MUSE_BOARD_AIPI
        default "espressif_box_3" if MUSE_BOARD_ESPRESSIF_BOX_3
        default "waveshare_c6_18" if MUSE_BOARD_WAVESHARE_C6_18
        default "waveshare_c6_206" if MUSE_BOARD_WAVESHARE_C6_206
        default "sensecap_watcher" if MUSE_BOARD_SENSECAP_WATCHER
        default "m5stack_sticks3" if MUSE_BOARD_M5STACK_STICKS3
        default "m5stack_stickc_plus2" if MUSE_BOARD_M5STACK_STICKC_PLUS2
        default "m5stack_cardputer_adv" if MUSE_BOARD_M5STACK_CARDPUTER_ADV
        default "m5stack_stopwatch" if MUSE_BOARD_M5STACK_STOPWATCH
        default "m5stack_cores3" if MUSE_BOARD_M5STACK_CORES3
        default "m5stack_core2" if MUSE_BOARD_M5STACK_CORE2
        default "fnk0104b" if MUSE_BOARD_FNK0104B
        default "guition_jc3248w535" if MUSE_BOARD_GUITION_JC3248W535
        default "waveshare_s3_lcd7" if MUSE_BOARD_WAVESHARE_S3_LCD7
        default "vn_s3_183" if MUSE_BOARD_VN_S3_183
        default "ai_passport" if MUSE_BOARD_AI_PASSPORT
        default "es3c28p" if MUSE_BOARD_ES3C28P
        default "none"

    # The Muse tools' serial port: the console UART behind the board's USB
    # bridge, where the chip's own USB Serial/JTAG isn't wired to a connector
    # (the Watcher's USB-C goes to a CH342) or the chip has none.
    config MUSE_CONSOLE_UART
        bool
        default y if MUSE_BOARD_SENSECAP_WATCHER || MUSE_BOARD_WAVESHARE_S3_LCD7 || !SOC_USB_SERIAL_JTAG_SUPPORTED

    # A board overlay can raise this for a quiet speaker.
    config MUSE_DEFAULT_VOLUME
        int "Speaker volume until one is chosen in settings (percent)"
        range 0 100
        default 70

    config MUSE_WATCHER_CAMERA
        bool "SenseCAP Watcher camera capture and live preview"
        depends on MUSE_BOARD_SENSECAP_WATCHER && SPIRAM
        default n
        help
            Enable the camera.capture Home Link command and the wheel
            double-click camera preview. Camera buffers and tasks consume
            memory and preview decoding shares CPU time with voice and Link.
            Leave disabled to build without camera support.

    config MUSE_CJK_FONT
        bool "Show Chinese and Japanese in captions"
        depends on MUSE_ENABLED
        default n
        help
            Captions fall back to GNU Unifont's 16x16 bitmaps for CJK
            punctuation, kana, the CJK Unified Ideographs and fullwidth
            forms that the ASCII caption font lacks. Small screens, whose
            captions are two lines of 8 px text, show a reply with CJK in it
            one 16 px line at a time. Takes about 850 KB of flash and no RAM.
            Without it those characters show as boxes. Hangul isn't
            included.

    config MUSE_JC3248W535_MIC_GPIO
        int "JC3248W535: GPIO for an external I2S mic's data (SD) line"
        depends on MUSE_BOARD_GUITION_JC3248W535
        range -1 48
        default -1
        help
            The board has a speaker amp but no microphone. Wire an I2S MEMS
            mic such as an INMP441 to the speaker's clocks (SCK to GPIO42, WS
            to GPIO2), L/R to GND, power to 3.3 V, and its SD line to a free
            GPIO, and set that GPIO here. -1 leaves push-to-talk recording
            silence.

    config MUSE_HATCH
        bool "Muse's own voice session"
        depends on MUSE_ENABLED
        default y if SPIRAM
        default n
        help
            Push-to-talk turns go over a voice session of Muse's own, to the
            VM Home Link is paired with or one set up on the device with a
            device token. Replies are text, shown as captions; start_tts in
            muse_chat_session.cpp is where a TTS API of your own can speak
            them. Needs PSRAM. Without it, voice notes go over Home Link's own
            session to its paired VM and replies are shown as text.

    config MUSE_DOUBAO_TTS
        bool "Speak replies with ByteDance Doubao Seed-TTS 2.0"
        depends on MUSE_HATCH
        default n
        help
            Synthesises each reply's text with ByteDance Doubao Seed-TTS 2.0
            over the OpenSpeech plan WebSocket (openspeech.bytedance.com) and
            plays the 24 kHz mono MP3 through the existing decoder/speaker
            path. The endpoint is reachable from mainland China. The board
            must have synced its clock over SNTP (TLS needs it). On any
            failure it falls back to the original silent captions.

    config MUSE_DOUBAO_TTS_TOKEN
        string "Doubao/Ark API key (ark-...)"
        depends on MUSE_DOUBAO_TTS
        default ""
        help
            The Ark API key used as OpenSpeech api_key and the Bearer token.
            This is a secret: put it in the local sdkconfig / a device overlay
            only, never commit it.

    config MUSE_DOUBAO_TTS_VOICE
        string "Doubao Seed-TTS voice_type"
        depends on MUSE_DOUBAO_TTS
        default "zh_female_vv_uranus_bigtts"
        help
            The Seed-TTS 2.0 voice_type (speaker). The default is a general
            female Mandarin voice verified against resource seed-tts-2.0.

    config MUSE_CN_CHAT
        bool "Route turns through Volcano Ark (domestic ASR + LLM)"
        depends on MUSE_HATCH
        default n
        help
            Replaces Muse's cloud dictation and chat with Volcano Engine Ark
            (火山方舟). A push-to-talk turn uploads the recorded WAV as an
            input_audio part of an audio-understanding Doubao model, which
            transcribes it and answers in one Chat Completions call; a typed
            turn sends plain text. The assistant's reply still goes through the
            existing Doubao Seed-TTS speaker path and the captions. No Muse
            pairing or Noise connection is needed once this is on. The board
            must have synced its clock over SNTP (TLS) and be able to reach
            ark.cn-beijing.volces.com.

    config MUSE_CN_ARK_TOKEN
        string "Ark API key for the domestic chat backend (ark-...)"
        depends on MUSE_CN_CHAT
        default ""
        help
            The Ark API key sent as the Bearer token. Leave empty to fall back
            to MUSE_DOUBAO_TTS_TOKEN so one key can cover chat and TTS. This is
            a secret: put it in a local, un-tracked sdkconfig overlay, never
            commit it.

    config MUSE_CN_API_BASE
        string "Ark Chat Completions base URL"
        depends on MUSE_CN_CHAT
        default "https://ark.cn-beijing.volces.com/api/plan/v3"
        help
            Base URL; /chat/completions is appended. The OpenSpeech/Ark API key
            authenticates against the plan gateway (/api/plan/v3); the regular
            Ark gateway (/api/v3) rejects a speech-console key with 401.

    config MUSE_CN_ASR_RESOURCE_ID
        string "Doubao Seed-ASR resource id"
        depends on MUSE_CN_CHAT
        default "volc.seedasr.sauc.duration"
        help
            The OpenSpeech plan-gateway resource id for streaming speech
            recognition (Doubao Seed-ASR 2.0). Voice turns upload 16 kHz mono
            PCM over wss://openspeech.bytedance.com/api/v3/plan/sauc/
            bigmodel_async using this resource, then the transcript is sent to
            the text LLM. The 1.0 fallback id is volc.bigasr.sauc.duration.

    config MUSE_CN_ASR_ENDPOINT
        string "Seed-ASR plan gateway endpoint path"
        depends on MUSE_CN_CHAT
        default "/api/v3/plan/sauc/bigmodel_async"
        help
            The plan-gateway ASR endpoint appended to the OpenSpeech host.
            bigmodel_async is the bidirectional streaming endpoint that serves
            Seed-ASR 2.0 under an Ark API key.

    config MUSE_CN_TEXT_MODEL
        string "LLM model id for chat turns"
        depends on MUSE_CN_CHAT
        default "ark-code-latest"
        help
            The model id sent in Chat Completions requests to the plan gateway.
            ark-code-latest is the OpenAI-compatible model served under the
            speech/Ark plan key; both ASR transcripts and typed text use it.

    config MUSE_CN_SYSTEM_PROMPT
        string "Robot persona system prompt"
        depends on MUSE_CN_CHAT
        default "你是一个友善的中文语音助手，用简洁口语化的中文回答，每次回复不超过两句话。"
        help
            The system message that sets the robot's persona and reply style.
            Keep replies short: they are spoken over the speaker.

endmenu
```
